## config/boards/shields/pillzmod_pro/Kconfig.defconfig
```kconfig
# Copyright (c) 2020 The ZMK Contributors
# SPDX-License-Identifier: MIT

if SHIELD_PILLZMOD_PRO

config ZMK_KEYBOARD_NAME
    default "My Kinesis"

config SPI
    default y
    
endif
```
